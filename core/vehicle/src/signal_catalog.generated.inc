/**
 * @file signal_catalog.generated.inc
 * @brief GENERATED FILE -- do not hand-edit. Produced by tools/gen_catalog.py
 * from core/vehicle/data/signals.json: that registry's "active" entries,
 * then its "internal" ones (WIP entries are excluded). Edit signals.json --
 * by hand, or via the monitor tool's Registry/Learn tabs -- and re-run the
 * script, then commit both. Included by signal_catalog.cpp inside `namespace core`, after
 * the transform_* function definitions it references by name.
 */

const UdsEcu UDS_ECUS[] = {
    { 0x7E0, 0x7E8 },
    { 0x7E1, 0x7E9 },
    { 0x70F, 0x779 },
    { 0x754, 0x7BE },
    { 0x714, 0x77E },
};
const uint8_t UDS_ECU_COUNT = 5;

/* Gear */
const EnumEntry ENUM_33[] = { { 0, "1" }, { 1, "2" }, { 2, "3" }, { 3, "4" }, { 4, "5" }, { 5, "6" }, { 6, "7" }, { 8, "N" } };

/* T Cool Valve */
const EnumEntry ENUM_35[] = { { 0, "Open" }, { 1, "Closed" } };

/* T Oil Cooler Valve */
const EnumEntry ENUM_36[] = { { 0, "N/A" }, { 1, "Open" }, { 2, "Closed" }, { 3, "Error" } };

const SignalSpec SIGNAL_CATALOG[] = {
    /* Cool Temp */
    { 0,
      "Cool Temp",
      UnitType::Temp,
      2000,
      { { 0xF4, 0x05, -40.0f, 1.0f, { 0, 0, false, 0, 0, false }, 0 }, { 0, 0, 0.0f, 0.0f, { 0, 0, false, 0, 0, false }, 0 } },
      1,
      transform_default,
      -40.0f,
      130.0f,
      nullptr, 0 },
    /* Eng Oil Temp */
    { 1,
      "Eng Oil Temp",
      UnitType::Temp,
      1000,
      { { 0x40, 0xD5, 0.0f, 0.1f, { 0, 0, false, 0, 0, false }, 0 }, { 0, 0, 0.0f, 0.0f, { 0, 0, false, 0, 0, false }, 0 } },
      1,
      transform_default,
      -40.0f,
      150.0f,
      nullptr, 0 },
    /* Int Air Temp */
    { 2,
      "Int Air Temp",
      UnitType::Temp,
      100,
      { { 0xF4, 0x0F, -40.0f, 1.0f, { 0, 0, false, 0, 0, false }, 0 }, { 0, 0, 0.0f, 0.0f, { 0, 0, false, 0, 0, false }, 0 } },
      1,
      transform_default,
      -40.0f,
      80.0f,
      nullptr, 0 },
    /* Charge Pres */
    { 3,
      "Charge Pres",
      UnitType::Pressure,
      100,
      { { 0x20, 0x2A, 0.0f, 0.001f, { 0, 0, false, 0, 0, false }, 0 }, { 0, 0, 0.0f, 0.0f, { 0, 0, false, 0, 0, false }, 0 } },
      1,
      transform_default,
      0.0f,
      3.0f,
      nullptr, 0 },
    /* Int Pres */
    { 4,
      "Int Pres",
      UnitType::Pressure,
      50,
      { { 0x3E, 0x70, 0.0f, 0.001f, { 0, 0, false, 0, 0, false }, 0 }, { 0, 0, 0.0f, 0.0f, { 0, 0, false, 0, 0, false }, 0 } },
      1,
      transform_default,
      0.0f,
      3.0f,
      nullptr, 0 },
    /* Amb Pres */
    { 5,
      "Amb Pres",
      UnitType::Pressure,
      1000,
      { { 0x13, 0xCA, 0.0f, 0.0001f, { 0, 0, false, 0, 0, false }, 0 }, { 0, 0, 0.0f, 0.0f, { 0, 0, false, 0, 0, false }, 0 } },
      1,
      transform_default,
      0.8f,
      1.1f,
      nullptr, 0 },
    /* Boost */
    { 22,
      "Boost",
      UnitType::Pressure,
      50,
      { { 0x13, 0xCA, 0.0f, 0.0001f, { 0, 0, false, 0, 0, false }, 0 }, { 0x3E, 0x70, 0.0f, 0.001f, { 0, 0, false, 0, 0, false }, 0 } },
      2,
      transform_difference,
      -1.0f,
      2.0f,
      nullptr, 0 },
    /* Engine Speed */
    { 7,
      "Engine Speed",
      UnitType::RPM,
      50,
      { { 0x20, 0x6E, 0.0f, 1.0f, { 0, 0, false, 0, 0, false }, 0 }, { 0, 0, 0.0f, 0.0f, { 0, 0, false, 0, 0, false }, 0 } },
      1,
      transform_default,
      0.0f,
      7500.0f,
      nullptr, 0 },
    /* Engine Torque */
    { 8,
      "Engine Torque",
      UnitType::Torque,
      50,
      { { 0x43, 0x7C, 0.0f, 0.1f, { 0, 0, false, 0, 0, false }, 0 }, { 0, 0, 0.0f, 0.0f, { 0, 0, false, 0, 0, false }, 0 } },
      1,
      transform_default,
      0.0f,
      500.0f,
      nullptr, 0 },
    /* Speed */
    { 9,
      "Speed",
      UnitType::Speed,
      100,
      { { 0x20, 0x33, 0.0f, 0.01f, { 0, 0, false, 0, 0, false }, 0 }, { 0, 0, 0.0f, 0.0f, { 0, 0, false, 0, 0, false }, 0 } },
      1,
      transform_default,
      0.0f,
      300.0f,
      nullptr, 0 },
    /* Fuel Vol */
    { 10,
      "Fuel Vol",
      UnitType::Volume,
      5000,
      { { 0x22, 0x06, 0.0f, 1.0f, { 0, 0, false, 0, 0, false }, 0 }, { 0, 0, 0.0f, 0.0f, { 0, 0, false, 0, 0, false }, 0 } },
      1,
      transform_default,
      0.0f,
      55.0f,
      nullptr, 0 },
    /* Fuel Pct */
    { 11,
      "Fuel Pct",
      UnitType::Percent,
      5000,
      { { 0xF4, 0x2F, 0.0f, 0.3922f, { 0, 0, false, 0, 0, false }, 0 }, { 0, 0, 0.0f, 0.0f, { 0, 0, false, 0, 0, false }, 0 } },
      1,
      transform_default,
      0.0f,
      100.0f,
      nullptr, 0 },
    /* Throttle Pos */
    { 12,
      "Throttle Pos",
      UnitType::Percent,
      50,
      { { 0xF4, 0x11, 0.0f, 0.3922f, { 0, 0, false, 0, 0, false }, 0 }, { 0, 0, 0.0f, 0.0f, { 0, 0, false, 0, 0, false }, 0 } },
      1,
      transform_default,
      0.0f,
      100.0f,
      nullptr, 0 },
    /* Misfire Cnt */
    { 13,
      "Misfire Cnt",
      UnitType::None,
      500,
      { { 0x29, 0x04, 0.0f, 1.0f, { 0, 0, false, 0, 0, false }, 0 }, { 0, 0, 0.0f, 0.0f, { 0, 0, false, 0, 0, false }, 0 } },
      1,
      transform_default,
      0.0f,
      500.0f,
      nullptr, 0 },
    /* Misfire Cnt Cyl 1 */
    { 14,
      "Misfire Cnt Cyl 1",
      UnitType::None,
      500,
      { { 0x29, 0x66, 0.0f, 1.0f, { 0, 0, false, 0, 0, false }, 0 }, { 0, 0, 0.0f, 0.0f, { 0, 0, false, 0, 0, false }, 0 } },
      1,
      transform_default,
      0.0f,
      200.0f,
      nullptr, 0 },
    /* Misfire Cnt Cyl 2 */
    { 15,
      "Misfire Cnt Cyl 2",
      UnitType::None,
      500,
      { { 0x29, 0x67, 0.0f, 1.0f, { 0, 0, false, 0, 0, false }, 0 }, { 0, 0, 0.0f, 0.0f, { 0, 0, false, 0, 0, false }, 0 } },
      1,
      transform_default,
      0.0f,
      200.0f,
      nullptr, 0 },
    /* Misfire Cnt Cyl 3 */
    { 16,
      "Misfire Cnt Cyl 3",
      UnitType::None,
      500,
      { { 0x29, 0x68, 0.0f, 1.0f, { 0, 0, false, 0, 0, false }, 0 }, { 0, 0, 0.0f, 0.0f, { 0, 0, false, 0, 0, false }, 0 } },
      1,
      transform_default,
      0.0f,
      200.0f,
      nullptr, 0 },
    /* Misfire Cnt Cyl 4 */
    { 17,
      "Misfire Cnt Cyl 4",
      UnitType::None,
      500,
      { { 0x29, 0x69, 0.0f, 1.0f, { 0, 0, false, 0, 0, false }, 0 }, { 0, 0, 0.0f, 0.0f, { 0, 0, false, 0, 0, false }, 0 } },
      1,
      transform_default,
      0.0f,
      200.0f,
      nullptr, 0 },
    /* Time Corr. Cyl 1 */
    { 18,
      "Time Corr. Cyl 1",
      UnitType::Angle,
      100,
      { { 0x20, 0x0A, 0.0f, 0.01f, { 0, 0, false, 0, 0, false }, 0 }, { 0, 0, 0.0f, 0.0f, { 0, 0, false, 0, 0, false }, 0 } },
      1,
      transform_default,
      -10.0f,
      10.0f,
      nullptr, 0 },
    /* Time Corr. Cyl 2 */
    { 19,
      "Time Corr. Cyl 2",
      UnitType::Angle,
      100,
      { { 0x20, 0x0B, 0.0f, 0.01f, { 0, 0, false, 0, 0, false }, 0 }, { 0, 0, 0.0f, 0.0f, { 0, 0, false, 0, 0, false }, 0 } },
      1,
      transform_default,
      -10.0f,
      10.0f,
      nullptr, 0 },
    /* Time Corr. Cyl 3 */
    { 20,
      "Time Corr. Cyl 3",
      UnitType::Angle,
      100,
      { { 0x20, 0x0C, 0.0f, 0.01f, { 0, 0, false, 0, 0, false }, 0 }, { 0, 0, 0.0f, 0.0f, { 0, 0, false, 0, 0, false }, 0 } },
      1,
      transform_default,
      -10.0f,
      10.0f,
      nullptr, 0 },
    /* Time Corr. Cyl 4 */
    { 21,
      "Time Corr. Cyl 4",
      UnitType::Angle,
      100,
      { { 0x20, 0x0D, 0.0f, 0.01f, { 0, 0, false, 0, 0, false }, 0 }, { 0, 0, 0.0f, 0.0f, { 0, 0, false, 0, 0, false }, 0 } },
      1,
      transform_default,
      -10.0f,
      10.0f,
      nullptr, 0 },
    /* Rad Out Temp */
    { 24,
      "Rad Out Temp",
      UnitType::Temp,
      2000,
      { { 0x20, 0x2B, 0.0f, 0.1f, { 0, 0, false, 0, 0, false }, 0 }, { 0, 0, 0.0f, 0.0f, { 0, 0, false, 0, 0, false }, 0 } },
      1,
      transform_default,
      0.0f,
      100.0f,
      nullptr, 0 },
    /* Cool Temp Delta */
    { 26,
      "Cool Temp Delta",
      UnitType::TempDelta,
      2000,
      { { 0x20, 0x2E, 0.0f, 0.1f, { 0, 0, false, 0, 0, false }, 0 }, { 0, 0, 0.0f, 0.0f, { 0, 0, false, 0, 0, false }, 0 } },
      1,
      transform_default,
      0.0f,
      100.0f,
      nullptr, 0 },
    /* Rad Fan 1 */
    { 28,
      "Rad Fan 1",
      UnitType::Percent,
      500,
      { { 0x20, 0x55, 0.0f, 0.01f, { 0, 2, false, 0, 0, false }, 0 }, { 0, 0, 0.0f, 0.0f, { 0, 0, false, 0, 0, false }, 0 } },
      1,
      transform_default,
      0.0f,
      100.0f,
      nullptr, 0 },
    /* Rad Fan 2 */
    { 29,
      "Rad Fan 2",
      UnitType::Percent,
      500,
      { { 0x20, 0x56, 0.0f, 0.01f, { 0, 2, false, 0, 0, false }, 0 }, { 0, 0, 0.0f, 0.0f, { 0, 0, false, 0, 0, false }, 0 } },
      1,
      transform_default,
      0.0f,
      100.0f,
      nullptr, 0 },
    /* IMRC Cmd */
    { 30,
      "IMRC Cmd",
      UnitType::Percent,
      100,
      { { 0x20, 0x69, 0.0f, 0.01f, { 0, 2, false, 0, 0, false }, 0 }, { 0, 0, 0.0f, 0.0f, { 0, 0, false, 0, 0, false }, 0 } },
      1,
      transform_default,
      0.0f,
      100.0f,
      nullptr, 0 },
    /* IMRC Ack */
    { 31,
      "IMRC Ack",
      UnitType::Percent,
      100,
      { { 0x20, 0x6A, 0.0f, 0.01f, { 0, 2, false, 0, 0, false }, 0 }, { 0, 0, 0.0f, 0.0f, { 0, 0, false, 0, 0, false }, 0 } },
      1,
      transform_default,
      0.0f,
      100.0f,
      nullptr, 0 },
    /* Gear */
    { 33,
      "Gear",
      UnitType::Enum,
      100,
      { { 0x21, 0x0F, 0.0f, 1.0f, { 0, 0, false, 0, 0, false }, 0 }, { 0, 0, 0.0f, 0.0f, { 0, 0, false, 0, 0, false }, 0 } },
      1,
      transform_default,
      0.0f,
      100.0f,
      ENUM_33, 8 },
    /* EGT */
    { 34,
      "EGT",
      UnitType::Temp,
      500,
      { { 0x29, 0x6F, 0.0f, 0.1f, { 0, 0, false, 0, 0, false }, 0 }, { 0, 0, 0.0f, 0.0f, { 0, 0, false, 0, 0, false }, 0 } },
      1,
      transform_default,
      0.0f,
      100.0f,
      nullptr, 0 },
    /* T Cool Valve */
    { 35,
      "T Cool Valve",
      UnitType::Enum,
      1000,
      { { 0x3D, 0x74, 0.0f, 1.0f, { 0, 0, false, 0, 0, false }, 0 }, { 0, 0, 0.0f, 0.0f, { 0, 0, false, 0, 0, false }, 0 } },
      1,
      transform_default,
      0.0f,
      100.0f,
      ENUM_35, 2 },
    /* T Oil Cooler Valve */
    { 36,
      "T Oil Cooler Valve",
      UnitType::Enum,
      1000,
      { { 0x3D, 0xB1, 0.0f, 1.0f, { 0, 0, false, 0, 0, false }, 0 }, { 0, 0, 0.0f, 0.0f, { 0, 0, false, 0, 0, false }, 0 } },
      1,
      transform_default,
      0.0f,
      100.0f,
      ENUM_36, 4 },
    /* Trans Fluid Temp */
    { 37,
      "Trans Fluid Temp",
      UnitType::Temp,
      1000,
      { { 0x21, 0x04, 0.0f, 1.0f, { 0, 2, false, 0, 0, true }, 1 }, { 0, 0, 0.0f, 0.0f, { 0, 0, false, 0, 0, false }, 0 } },
      1,
      transform_default,
      0.0f,
      100.0f,
      nullptr, 0 },
    /* Clutch 1 Torque */
    { 38,
      "Clutch 1 Torque",
      UnitType::Torque,
      50,
      { { 0x38, 0x2E, 0.0f, 0.05f, { 0, 2, true, 0, 0, true }, 1 }, { 0, 0, 0.0f, 0.0f, { 0, 0, false, 0, 0, false }, 0 } },
      1,
      transform_default,
      0.0f,
      100.0f,
      nullptr, 0 },
    /* Clutch 2 Torque */
    { 39,
      "Clutch 2 Torque",
      UnitType::Torque,
      50,
      { { 0x38, 0x38, 0.0f, 0.05f, { 0, 2, true, 0, 0, true }, 1 }, { 0, 0, 0.0f, 0.0f, { 0, 0, false, 0, 0, false }, 0 } },
      1,
      transform_default,
      0.0f,
      100.0f,
      nullptr, 0 },
    /* Clutch Oil Temp */
    { 40,
      "Clutch Oil Temp",
      UnitType::Temp,
      1000,
      { { 0x38, 0xB2, 0.0f, 1.0f, { 0, 2, false, 0, 0, true }, 1 }, { 0, 0, 0.0f, 0.0f, { 0, 0, false, 0, 0, false }, 0 } },
      1,
      transform_default,
      0.0f,
      100.0f,
      nullptr, 0 },
    /* Clutch 2 Pres */
    { 41,
      "Clutch 2 Pres",
      UnitType::Pressure,
      50,
      { { 0x38, 0xEA, 0.0f, 0.01f, { 0, 2, false, 0, 0, true }, 1 }, { 0, 0, 0.0f, 0.0f, { 0, 0, false, 0, 0, false }, 0 } },
      1,
      transform_default,
      0.0f,
      100.0f,
      nullptr, 0 },
    /* Clutch 1 Pres */
    { 42,
      "Clutch 1 Pres",
      UnitType::Pressure,
      50,
      { { 0x38, 0xEB, 0.0f, 0.01f, { 0, 2, false, 0, 0, true }, 1 }, { 0, 0, 0.0f, 0.0f, { 0, 0, false, 0, 0, false }, 0 } },
      1,
      transform_default,
      0.0f,
      100.0f,
      nullptr, 0 },
    /* AWD Ctrl Temp */
    { 47,
      "AWD Ctrl Temp",
      UnitType::Temp,
      500,
      { { 0x02, 0x8D, -55.0f, 1.0f, { 0, 1, false, 0, 0, false }, 2 }, { 0, 0, 0.0f, 0.0f, { 0, 0, false, 0, 0, false }, 0 } },
      1,
      transform_default,
      0.0f,
      100.0f,
      nullptr, 0 },
    /* AWD Pump Curr */
    { 48,
      "AWD Pump Curr",
      UnitType::Current,
      100,
      { { 0x2B, 0xE6, 0.0f, 0.001f, { 0, 2, false, 0, 0, false }, 2 }, { 0, 0, 0.0f, 0.0f, { 0, 0, false, 0, 0, false }, 0 } },
      1,
      transform_default,
      0.0f,
      100.0f,
      nullptr, 0 },
    /* AWD Clutch Temp */
    { 49,
      "AWD Clutch Temp",
      UnitType::Temp,
      500,
      { { 0x2B, 0xF1, -22767.0f, 0.01f, { 0, 2, false, 0, 0, true }, 2 }, { 0, 0, 0.0f, 0.0f, { 0, 0, false, 0, 0, false }, 0 } },
      1,
      transform_default,
      0.0f,
      100.0f,
      nullptr, 0 },
    /* AWD Clutch Status */
    { 50,
      "AWD Clutch Status",
      UnitType::Percent,
      100,
      { { 0x2B, 0xF3, 0.0f, 0.3937f, { 0, 1, false, 0, 0, false }, 2 }, { 0, 0, 0.0f, 0.0f, { 0, 0, false, 0, 0, false }, 0 } },
      1,
      transform_default,
      0.0f,
      100.0f,
      nullptr, 0 },
    /* AWD Clutch PWM */
    { 51,
      "AWD Clutch PWM",
      UnitType::Percent,
      100,
      { { 0x2B, 0xE7, 0.0f, 1.0f, { 0, 0, false, 0, 0, false }, 2 }, { 0, 0, 0.0f, 0.0f, { 0, 0, false, 0, 0, false }, 0 } },
      1,
      transform_default,
      0.0f,
      100.0f,
      nullptr, 0 },
    /* AWD Clutch Volt */
    { 52,
      "AWD Clutch Volt",
      UnitType::Voltage,
      100,
      { { 0x2B, 0xE9, 0.0f, 0.1f, { 0, 1, false, 0, 0, false }, 2 }, { 0, 0, 0.0f, 0.0f, { 0, 0, false, 0, 0, false }, 0 } },
      1,
      transform_default,
      0.0f,
      100.0f,
      nullptr, 0 },
    /* AWD Cool Fin Temp */
    { 53,
      "AWD Cool Fin Temp",
      UnitType::Temp,
      1000,
      { { 0x2B, 0xE4, -22767.0f, 0.01f, { 0, 2, false, 0, 0, true }, 2 }, { 0, 0, 0.0f, 0.0f, { 0, 0, false, 0, 0, false }, 0 } },
      1,
      transform_default,
      0.0f,
      100.0f,
      nullptr, 0 },
    /* AWD OvrTemp Time */
    { 54,
      "AWD OvrTemp Time",
      UnitType::Time,
      5000,
      { { 0x2B, 0xE5, 0.0f, 1.0f, { 0, 2, false, 0, 0, false }, 2 }, { 0, 0, 0.0f, 0.0f, { 0, 0, false, 0, 0, false }, 0 } },
      1,
      transform_default,
      0.0f,
      100.0f,
      nullptr, 0 },
    /* AWD Axle Delta */
    { 55,
      "AWD Axle Delta",
      UnitType::Speed,
      100,
      { { 0x2B, 0xF0, 0.0f, 0.1f, { 0, 2, false, 0, 0, false }, 2 }, { 0, 0, 0.0f, 0.0f, { 0, 0, false, 0, 0, false }, 0 } },
      1,
      transform_default,
      0.0f,
      100.0f,
      nullptr, 0 },
    /* F Axle Height */
    { 58,
      "F Axle Height",
      UnitType::Length,
      100,
      { { 0x2D, 0x06, 0.0f, 0.1f, { 0, 0, false, 0, 0, false }, 3 }, { 0, 0, 0.0f, 0.0f, { 0, 0, false, 0, 0, false }, 0 } },
      1,
      transform_default,
      0.0f,
      100.0f,
      nullptr, 0 },
    /* R Axle Height */
    { 59,
      "R Axle Height",
      UnitType::Length,
      100,
      { { 0x2D, 0x07, 0.0f, 0.1f, { 0, 0, false, 0, 0, false }, 3 }, { 0, 0, 0.0f, 0.0f, { 0, 0, false, 0, 0, false }, 0 } },
      1,
      transform_default,
      0.0f,
      100.0f,
      nullptr, 0 },
    /* Amb Light */
    { 60,
      "Amb Light",
      UnitType::Illuminance,
      100,
      { { 0x25, 0xB8, 0.0f, 1.0f, { 0, 2, false, 0, 0, false }, 3 }, { 0, 0, 0.0f, 0.0f, { 0, 0, false, 0, 0, false }, 0 } },
      1,
      transform_default,
      0.0f,
      100.0f,
      nullptr, 0 },
    /* Internal: the firmware's own, never offered to the user (see
     * SIGNAL_CATALOG_COUNT). */
    /* Dim Ctrl */
    { 61,
      "Dim Ctrl",
      UnitType::Percent,
      500,
      { { 0x11, 0x00, 0.0f, 1.0f, { 2, 1, false, 0, 0, false }, 4 }, { 0, 0, 0.0f, 0.0f, { 0, 0, false, 0, 0, false }, 0 } },
      1,
      transform_default,
      0.0f,
      100.0f,
      nullptr, 0 },
};

inline constexpr size_t SIGNAL_CATALOG_JSON_COUNT = 50;
inline constexpr size_t INTERNAL_SIGNAL_JSON_COUNT = 1;
static_assert(SIGNAL_CATALOG_JSON_COUNT == SIGNAL_CATALOG_COUNT
                  && INTERNAL_SIGNAL_JSON_COUNT == INTERNAL_SIGNAL_COUNT,
    "signal_catalog.hpp's SIGNAL_CATALOG_COUNT/INTERNAL_SIGNAL_COUNT must match"
    " signals.json's entry counts -- re-run tools/gen_catalog.py");
